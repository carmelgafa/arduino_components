/*

*/

#include <SoftwareSerial.h>

SoftwareSerial s1(2,3);

int dist;
int strength;
float temp;
byte check;
int i;
byte uart[9];
const byte HEADER = 0x59;

void setup()
{
  Serial.begin(9600);
  Serial1.begin(115200);
  
  Serial.print("setup concluded.");
}

void loop()
{
  
  delay(10);
  
  if(Serial1.available())
  {
    
    uart[0] = Serial1.read();
    uart[1] = Serial1.read();
      
    if((uart[0] == HEADER) || (uart[1] == HEADER))
    {
      
      for(i=2; i<9; i++)
      {
        uart[i] = Serial1.read();
      }
      
      check = uart[0]+uart[1]+uart[2]+uart[3]+uart[4]+uart[5]+uart[6]+uart[7];
      
      if(uart[8] == (check & 0xff))
      {
        
        dist = uart[2] + uart[3]*0xff;
        Serial.print("distance: ");
        Serial.print(dist);
        Serial.print("\n");
        
        strength = uart[4] + uart[5]*0xff;
        Serial.print("strength: ");
        Serial.print(strength);
        Serial.print("\n");
        
        temp = (uart[6] + uart[7]*0xff)/8 - 256;
        Serial.print("temperature: ");
        Serial.print(temp);
        Serial.print("\n");

      }
      else
      {
        // Serial.print("fail");
        while(Serial1.read() >= 0) ; // flush the receive buffer
        Serial1.flush();
        // Serial.print("\n");

      }
      
      
    }
    else
    {
      // Serial.print("Incorrect header ");
      // Serial.print(uart[0]);
      // Serial.print("\t");
      // Serial.print(uart[1]);
      // Serial.print("\n");
      while(Serial1.read() >= 0) ; // flush the receive buffer
      Serial1.flush();
    }
  }
}
